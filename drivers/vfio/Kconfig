## drivers/vfio/Kconfig
```kconfig
config VFIO_IOMMU_X86
	tristate
	depends on VFIO && X86
	default n

menuconfig VFIO
	tristate "VFIO Non-Privileged userspace driver framework"
	depends on IOMMU_API
	select VFIO_IOMMU_X86 if X86
	help
	  VFIO provides a framework for secure userspace device drivers.
	  See Documentation/vfio.txt for more details.

	  If you don't know what to do here, say N.
```
